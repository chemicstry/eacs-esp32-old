## main/Kconfig.projbuild
```kconfig
menu "RFID Module Configuration"

menu "Network Settings"

config USE_ETH
    bool "Enable Ethernet connectivity"
    default false
    help
        Enables Ethernet connectivity

config USE_WIFI
    bool "Enable WiFi connectivity"
    default false
    help
        Enables WiFi connectivity

config WIFI_SSID
    string "WiFi SSID"
	default "myssid"
    depends on USE_WIFI
	help
		SSID (network name).

config WIFI_PASSWORD
    string "WiFi Password"
	default "passwd"
    depends on USE_WIFI
	help
		WiFi password (WPA or WPA2).

		Can be left blank if the network has no security set.

config USE_MDNS
    bool "mDNS service discovery"
    default true
    help
        Enables mDNS automatic service discovery

endmenu

menu "SERVER"

config SERVER_USE_MDNS
    bool "Use mDNS"
    depends on USE_MDNS
    default false

config SERVER_HOST
    string "Server host"
    depends on !SERVER_USE_MDNS
    default "0.0.0.0"

config SERVER_PORT
    int "Server port"
    depends on !SERVICE_TAG_AUTH_USE_MDNS
    default 3000

config SERVER_SSL
    bool "Use SSL"
    default true

config SERVER_SSL_FINGERPRINT
    string "SSL fingerprint"
    depends on SERVICE_TAG_AUTH_SSL

config SERVER_TOKEN
    string "Authentication token"

endmenu

menu "IO configuration"

config RELAY_PIN
    int "Relay pin"
    default 32

config BUZZER_PIN
    int "Buzzer pin"
    default 16

config BUZZER_PWM
    bool "Use PWM for buzzer"
    default false

config READER_BUTTON_PIN
    int "Reader button pin"
    default 14

config EXIT_BUTTON_PIN
    int "Exit button pin"
    default 13

config READER_UART_NUM
    int "PN532 reader UART interface number"
    default 2

config READER_RX_PIN
    int "PN532 reader serial RX pin"
    default 36

config READER_TX_PIN
    int "PN532 reader serial TX pin"
    default 4

endmenu

config DOOR_OPEN_DURATION
    int "Door open duration"
    default 3000
    help
        Time in ms for how long to keep doors opened after succesfull authentication

endmenu
```

## sdkconfig.defaults
```kconfig
# Enable C++ exceptions
CONFIG_CXX_EXCEPTIONS=y

# Set default flash size to 4MB
CONFIG_ESPTOOLPY_FLASHSIZE_4MB=y

# Increase pthread stack size
CONFIG_ESP32_PTHREAD_TASK_STACK_SIZE_DEFAULT=8192
```
